## boards/viewe/uedx48270043e_wb_a/Kconfig.defconfig
```kconfig
# Copyright (c) 2024 Espressif Systems (Shanghai) Co., Ltd.
# Copyright (c) 2026 VIEWE Display Co., Ltd.
# SPDX-License-Identifier: Apache-2.0

if BOARD_UEDX48270043E_WB_A_ESP32S3_PROCPU

config ESP_SPIRAM
	default y

choice SPIRAM_MODE
	default SPIRAM_MODE_OCT
endchoice

choice SPIRAM_SPEED
	default SPIRAM_SPEED_80M
endchoice

choice ESP32S3_DATA_CACHE_SIZE
	default ESP32S3_DATA_CACHE_64KB
endchoice

choice ESP32S3_DATA_CACHE_LINE_SIZE
	default ESP32S3_DATA_CACHE_LINE_64B
endchoice

config ESP_SPIRAM_HEAP_SIZE
	default 4194304 if ESP_SPIRAM

config DISPLAY_ESP32_LCD_CAM_RGB_BOUNCE_BUFFER_LINES
	default 17 if DISPLAY_ESP32_LCD_CAM_RGB

endif # BOARD_UEDX48270043E_WB_A_ESP32S3_PROCPU
```

## boards/viewe/uedx48270043e_wb_a/Kconfig.uedx48270043e_wb_a
```kconfig
# Copyright (c) 2024 Espressif Systems (Shanghai) Co., Ltd.
# Copyright (c) 2026 VIEWE Display Co., Ltd.
# SPDX-License-Identifier: Apache-2.0

config BOARD_UEDX48270043E_WB_A
	select SOC_ESP32S3
	select SOC_ESP32S3_PROCPU if BOARD_UEDX48270043E_WB_A_ESP32S3_PROCPU
	select SOC_ESP32S3_APPCPU if BOARD_UEDX48270043E_WB_A_ESP32S3_APPCPU
	select SOC_ESP32S3_WROOM_N16R8
```

## boards/viewe/uedx48270043e_wb_a/board.yml
```yaml
board:
  name: uedx48270043e_wb_a
  full_name: VIEWE UEDX48270043E-WB-A 4.3-inch 480x272 Touch Display
  vendor: viewe
  socs:
    - name: esp32s3
```

## boards/viewe/uedx80480043e_wb_a/board.yml
```yaml
board:
  name: uedx80480043e_wb_a
  full_name: VIEWE UEDX80480043E-WB-A 4.3-inch 800x480 Touch Display
  vendor: viewe
  socs:
    - name: esp32s3
```
